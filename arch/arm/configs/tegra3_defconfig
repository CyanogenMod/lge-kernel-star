## drivers/bssq/Kconfig
```kconfig
#drivers/bssq/Kconfig

menu "LGE BSSQ device driver"

config BSSQ_FUELGAUGE
	bool "Fuel gauge MAX17043"
	depends on I2C && MACH_BSSQ
	default y
	help
		Support for MAX17043 fuel gauge driver.

config BSSQ_MUIC_TI
	bool "MUIC TS5USBA33402"
	depends on MACH_BSSQ
	default y
	help
		Support for TS5USBA33402 MUIC driver.

config BSSQ_CHARGER_RT
	bool "Charger ic RT9524"
	depends on (LU6500 || SU880 || KU8800)
	default n
	help
		Support for RT9524 charger ic driver.
		
config BSSQ_CHARGER_MAX
	bool "Charger IC MAX8971"
	depends on (KS1001 || KS1103)
	default n
	help
		Support for MAX8971 charger IC driver.

config BSSQ_HW_REV
	bool "LGE HW PCB Revision"
	depends on MACH_BSSQ
	default y
	help
		Read HW PCB Revision.
config BSSQ_PROXIMITY
	bool "BSSQ Proximity Sensor"
	depends on MACH_BSSQ
	default y
	help
		BSSQ Proximity Sensor

config SUBPMIC_LP8720
	bool "SUB PMIC LP8720"
	default n
	help
		Support for LP8720 SUB PMIC driver.

#config CAM_PMIC
#	bool "CAM_PMIC"
#	default n
#	help
#		Support for CAM PMIC driver.

config BSSQ_TOUCH_LED
	bool "Bssq TouchLED Driver"
	depends on (LU6500 )
	default y
	help
		Touch LED driver
config BSSQ_QWERTY_LED
	bool "Bssq QWERTY LED Driver - MAX8907C WLED Port"
	default y
	help
		Qwerty LED driver

config BSSQ_RIL
	bool "Star RIL Driver"
	default y
	help
		Suport for IFX MUX & SPI.

config SPI_MDM6600
	bool "SPI MDM6600 from Qualcomm"
	default y
	help
	Enable this driver to support MDM6600 Modem
	
config RINETWORK_DRIVER
	bool "Raw ip network driver"
	default y
	help
	  Support for raw ip network driver.
	  
config BSSQ_CPWATCHER
	bool "Star CP Status Watcher Driver"
	default y
	help
	 Suport for CP Status Watcher driver.

config DUAL_SPI	 
	bool "DUAL SPI SUPPORT"
	default n
	help
	 Suport for DUAL SPI.

# 20110505 hyeongwon.oh@lge.com add battery driver [S]
config BSSQ_BATTERY
	bool "Bssq Battery driver"
	depends on MACH_BSSQ
	default y
	help
		Support for BSSQ Battery driver.
# 20110505 hyeongwon.oh@lge.com add battery driver [E]

# 20110427 unyou.shim@lge.com added vibrator [S]
#config BSSQ_VIBRATOR
#    bool "Bssq PWM Vibrator"
#    depends on MACH_BSSQ
#    default y
#    select TEGRA_PWM
#    help
#      PWM Vibrator
# 20110427 unyou.shim@lge.com added vibrator [E]

endmenu
```

## drivers/kpd/Kconfig
```kconfig
#
# pyocool.cho@lge.com
#
# driver/kpd/Kconfig
#
config PANICRPT
	bool "Panic report driver"
	#depends on (DUMMY_CONSOLE && FRAMEBUFFER_CONSOLE)
	default y
	help
		support for panic report driver.
```

## drivers/media/video/tegra/Kconfig
```kconfig
source "drivers/media/video/tegra/avp/Kconfig"
source "drivers/media/video/tegra/mediaserver/Kconfig"

config TEGRA_CAMERA
        bool "Enable support for tegra camera/isp hardware"
        depends on ARCH_TEGRA
        default y
        help
          Enables support for the Tegra camera interface

          If unsure, say Y

config VIDEO_OV5650
        tristate "OV5650 camera sensor support"
        depends on I2C && ARCH_TEGRA
        ---help---
          This is a driver for the Omnivision OV5650 5MP camera sensor
          for use with the tegra isp.

config VIDEO_OV2710
        tristate "OV2710 camera sensor support"
        depends on I2C && ARCH_TEGRA
        ---help---
          This is a driver for the Omnivision OV2710 camera sensor
          for use with the tegra isp.

config TORCH_SSL3250A
        tristate "SSL3250A flash/torch support"
        depends on I2C && ARCH_TEGRA
        ---help---
          This is a driver for the SSL3250A flash/torch camera device

config VIDEO_SH532U
        tristate "SH532U focuser support"
        depends on I2C && ARCH_TEGRA
        ---help---
          This is a driver for the SEMCO SH532U focuser
          for use with the tegra isp.
```

## drivers/misc/mpu3050/Kconfig
```kconfig
menu "Motion Sensors Support"

choice
    tristate "Motion Processing Unit"
    depends on I2C
    optional

config SENSORS_MPU3050
    tristate "MPU3050"
    help
      If you say yes here you get support for the MPU3050 Gyroscope driver
      This driver can also be built as a module.  If so, the module
      will be called mpu3050.

config SENSORS_MPU6000
    tristate "MPU6000"
    help
      If you say yes here you get support for the MPU6000 Gyroscope driver
      This driver can also be built as a module.  If so, the module
      will be called mpu6000.

endchoice

choice
    prompt "Accelerometer Type"
    depends on SENSORS_MPU3050
    optional

config SENSORS_KXTF9_MPU
    bool "Kionix KXTF9"
    help
      This enables support for the Kionix KXFT9 accelerometer

endchoice

choice
    prompt "Compass Type"
    depends on SENSORS_MPU6000 || SENSORS_MPU3050
    optional

config SENSORS_AK8975_MPU
    bool "AKM ak8975"
    help
      This enables support for the AKM ak8975 compass

endchoice

config SENSORS_MPU_DEBUG
    bool "MPU debug"
    depends on SENSORS_MPU3050 || SENSORS_MPU6000
    help
      If you say yes here you get extra debug messages from the MPU3050
      and other slave sensors.

endmenu
```

## drivers/misc/tegra-baseband/Kconfig
```kconfig
menuconfig TEGRA_BB_SUPPORT
	bool "Tegra baseband support"
	depends on ARCH_TEGRA
	---help---
	  Say Y here to get to see options for tegra baseband support.
	  This option alone does not add any kernel code.

	  If you say N, all options in this submenu will be skipped and disabled.

if TEGRA_BB_SUPPORT

config TEGRA_BB_POWER
	bool "Enable tegra baseband power driver"
	---help---
	 Adds power management driver for managing different baseband
	 modems with tegra processor.

	 This driver should work with at least the following devices:

            * STE M7400
            * ...

	 Disabled by default. Choose Y here if you want to build the driver.

config TEGRA_BB_M7400
	bool "Enable driver for M7400 modem"
	---help---
	 Enables driver for M7400 modem.

	 Disabled by default. Choose Y here if you want to build the driver.

endif # TEGRA_BB_SUPPORT
```

## drivers/mmc/Kconfig
```kconfig
#
# MMC subsystem configuration
#

menuconfig MMC
	tristate "MMC/SD/SDIO card support"
	depends on HAS_IOMEM
	help
	  This selects MultiMediaCard, Secure Digital and Secure
	  Digital I/O support.

	  If you want MMC/SD/SDIO support, you should say Y here and
	  also to your specific host controller driver.

config EMBEDDED_MMC_START_OFFSET
	bool "MMC start sector offset"
	depends on MMC != n
	help
	  This enables a per-controller fixed offset in sectors / bytes to
	  the location of the master boot record in the device, and reduces
	  the capacity of the device by a corresponding amount.  This is
	  primarily used by embedded systems with embedded MMC storage where
	  the initial sectors are used by boot firmware.  If you do not know
	  if this applies to your system, say N here.


config MMC_DEBUG
	bool "MMC debugging"
	depends on MMC != n
	help
	  This is an option for use by developers; most people should
	  say N here.  This enables MMC core and driver debugging.

if MMC

source "drivers/mmc/core/Kconfig"

source "drivers/mmc/card/Kconfig"

source "drivers/mmc/host/Kconfig"

endif # MMC
```

## drivers/net/wireless/bcm4329/Kconfig
```kconfig
config BCM4329
	tristate "BCM4329 wireless support"
#	depends on WLAN_80211
	select WIRELESS_EXT
	---help---
	  This is a driver for the Broadcom 4329 wireless chip.

config BCM4329_DEBUG
	bool "Debug"
	default n
	depends on BCM4329

config LGE_BCM432X_PATCH
	bool "BCM432X Patch by LGE"
	default y
	depends on BCM4329

config BCM4329_GPIO_BT_RESET
	int "GPIO BT_RESET"
	default 93
	depends on BCM4329

config BCM4329_GPIO_WL_RESET
	int "GPIO WL_RESET"
	default 110
	depends on BCM4329

config BRCM_LGE_WL_HOSTWAKEUP
	bool "Support BCM4325/BCM4329 Host Wakeup function"
	default n
	depends on BCM4329

config BRCM_LGE_WL_PKTFILTER
	bool "Setting Multicat/Broadcast packet fillter."
	default n
	depends on BCM4329

config BRCM_LGE_WL_ARPOFFLOAD
	bool "Use Arp offload function."
	default n
	depends on BCM4329

config BRCM_GPIO_INTR
	bool "Use Broadcom Host Wakeup GPIO"
	default n
	depends on BCM4329
	---help---
	   This function is activated only if set CONFIG_HAS_EARLYSUSPEND.	

config BCM4329_GPIO_WL_HOSTWAKEUP
	int "GPIO WL_HOSTWAKEUP"
	default 107
	depends on BCM4329

config BRCM_USE_DEEPSLEEP
	bool "Use deepsleep instead of dhd_dev_reset"
	default n
	depends on BCM4329
	---help---
	   Use deepsleep instead of dhd_dev_reset and controlling GPIO when driver start or stop.

config BRCM_USE_SOFTAP
	bool "Use SoftAP"
	default n
	depends on BCM4329
	---help---
	   Using Softap feature.

# config BCM4329_GPIO_WL_REGON
#	int "GPIO WL_REGON"
#	default 21
#	depends on LG_FW_BCM4329

config BRCM_USE_STATIC_BUF
	bool "Use static buff of osl_malloc"
	default n
	depends on BCM4329
config LGE_WMM_SKT
	bool "Use WMM rule for SKT"
	default n
	depends on BCM4329
```

## drivers/net/wireless/bcmdhd/Kconfig
```kconfig
config BCMDHD
	tristate "Broadcom 4329/30 wireless cards support"
	depends on MMC
	---help---
	  This module adds support for wireless adapters based on
	  Broadcom 4329/30 chipset.

	  This driver uses the kernel's wireless extensions subsystem.

	  If you choose to build a module, it'll be called dhd. Say M if
	  unsure.

config BCMDHD_FW_DIR
	depends on BCMDHD
	string "Firmware path"
	default "/system/vendor/firmware"
	---help---
	  Path to the firmware file.

config BCMDHD_NVRAM_DIR
	depends on BCMDHD
	string "NVRAM path"
	default "/system/etc"
	---help---
	  Path to the calibration file.

config BCMDHD_WEXT
	bool "Enable WEXT support"
	depends on BCMDHD && CFG80211 = n
	select WIRELESS_EXT
	select WEXT_PRIV
	help
	  Enables WEXT support

config BCMDHD_WIFI_CONTROL_FUNC
	bool "Use bcmdhd_wlan device"
	depends on BCMDHD
	default n
	---help---
	  Use this option to get various parameters from architecture specific
	  bcmdhd_wlan platform device. Say n if unsure.

config BCMDHD_HW_OOB
	bool "Use out of band interrupt"
	depends on BCMDHD
	default n
	---help---
	  Use out of band interrupt for card interrupt and wake on wireless.
```
