## drivers/staging/iio/light/Kconfig
```kconfig
#
# Light sensors
#
comment "Light sensors"

config TSL2561
	tristate "TAOS TSL2561 light-to-digital convertor"
	depends on I2C
	help
	 Say yes bere to build support for the TAOS light to digital
	 convertor.  This chip has two light sensors. One is broadband
	 including infrared whilst the other measures only infrared.
	 Provides direct access via sysfs.

config ISL29018
	tristate "ISL 29018 light and proximity sensor"
	depends on I2C
	default n
	help
	 If you say yes here you get support for ambient light sensing and
	 proximity ir sensing from intersil ISL29018.
	 This driver will provide the measurements of ambient light intensity
	 in lux, proximity infrared sensing and normal infrared sensing.
	 Data from sensor is accessible via sysfs.
```

## drivers/star/Kconfig
```kconfig
#drivers/heaven/Kconfig

menu "LGE STAR device driver"

config STAR_BATTERY_CHARGER
	bool "Star Battery & Charger Driver"
	default y
	depends on MACH_STAR
	help
	 Support for Battery & Charger Driver.
	
config STAR_MUIC
	bool "Star Muic MAXIM Driver"
	default y
	depends on MACH_STAR
	help
	 Support for muic MAX14526 driver.

config STAR_MUIC_TI
	bool "Star Muic TI Driver"
	default y
	depends on MACH_STAR
	help
	 Support for muic TS5USBA33402 driver.

config STAR_PROXIMITY
	bool "Star Proximity Sensor Driver"
	default y
	depends on MACH_STAR
	help
	 Suport for proximity sensor.

config STAR_HEADSET_DET
	bool "Star Headset Detection Driver"
	default y
	depends on MACH_STAR
	help
	 Suport for headset detection driver.

config STAR_RIL
	bool "Star RIL Driver"
	default y
	depends on MACH_STAR
	help
	 Suport for IFX MUX & SPI.

config RINETWORK_DRIVER
	bool "Raw ip network driver"
	default y
	depends on MACH_STAR
	help
	  Support for raw ip network driver.

config LOGGER
	bool "High-speed in-kernel logging driver"
	default y
	depends on !ANDROID_LOGGER	

source "drivers/star/sensor/Kconfig"

config STAR_POWERKEY
    bool "Star Powerkey Driver"
    default y
    depends on MACH_STAR
    help
      Powerkey driver

config STAR_VIBRATOR
    bool "Star Vibrator Driver"
    default y
    depends on MACH_STAR
    help
      Vibrator driver

config STAR_HOMEKEY
    bool "Star Homekey Driver"
    default n
    depends on MACH_STAR
    help
      Homekey driver

config STAR_TOUCH_LED
    bool "Star TouchLED Driver"
    default y
    depends on MACH_STAR
    help
      Touch LED driver

config STAR_HDMI_REG
    bool "Star HDMI Regulator Driver"
    default y
    depends on MACH_STAR
    help
      HDMI regulator driver

config STAR_WM8994_TEST
	bool "Star wm8994 Driver"
	default y
	help
	 Support for wm8994 driver.

config STAR_ERS_TEST
	bool "Star ERS Test Driver"
	default y
	help
	 ERS Test Driver

config STAR_FOTA
	bool "Star FOTA Test Driver"
	default y
	help
	 FOTA Test Driver	

config STAR_CPWATCHER
	bool "Star CP Status Watcher Driver"
	default y
	depends on MACH_STAR
	help
	 Suport for CP Status Watcher driver.

config STAR_HALL
	bool "Star Hall Driver"
	default y
	depends on MACH_STAR
	help
	 driver for hall ic

config STAR_BL
    bool "Star Backlight Driver"
    default y
    depends on MACH_STAR
    help
     driver for star Backlight

config LGE_ATS_INPUT_DEVICE
    bool "Support LGE ATS Input Device"
    default y
    depends on MACH_STAR
    help
     Choose if use ATS input device used for generating input event from user space

config STAR_BD_ADDRESS
	bool "BD Read / Write Driver"
	default y
	help
	  LGE added: It supports Bluetooth address Read / Write functionality on user mode.	  
            
endmenu
```

## drivers/star/sensor.module/Kconfig
```kconfig
# drivers/star/sensor/Kconfig
config STAR_SENSORS
    bool "Star Sensor Drivers for module load" 
    default y
	depends on !STAR_COMPASS && !STAR_GYRO_ACCEL
    help
      Support for all sensors initialization. If you want to load sensor drivers
	  for module type, you have to check this option. And should uncheck STAR_COMPASS,
	  STAR_GYRO_ACCEL option.

config STAR_COMPASS2
    tristate "Star Compass Driver for Module"
    default m
	depends on STAR_SENSORS
    help
      AMI304 driver

config STAR_ACCELEROMETER2
    tristate "Star Accelerometer Driver for Module"
    default m
	depends on STAR_SENSORS
    help
      Support for accelerometer driver simultanously.

config STAR_GYROSCOPE2
    tristate "Star Gyroscope Driver for Module"
    default m
	depends on STAR_SENSORS
    help
      Support for gyroscope/accelerometer driver simultanously.
```

## drivers/star/sensor/Kconfig
```kconfig
# drivers/star/sensor/Kconfig

config STAR_COMPASS
    bool "Star Compass Driver"
    default y
    help
      AMI304 driver

config STAR_GYRO_ACCEL
    bool "Star Gyroscope/Accelerometer Driver for Rev.C"
    default y
    help
      Support for gyroscope/accelerometer driver simultanously.

config LGE_STAR_SENSOR_VERIFY
    bool "Verify Star Sensor modules"
    default y
    help
      Verify Star sensor modules, 
	  Not avalable, kernel panic will happen and be reset. 
```

## drivers/video/tegra/Kconfig
```kconfig
config FB_TEGRA
	boolean "NVIDIA Tegra graphics support"
	depends on FB && ARCH_TEGRA
        default FB
	help
	  Graphics services for NVIDIA Tegra products

config FB_TEGRA_DUMMY
	boolean "Tegra dummy framebuffer driver"
	depends on FB_TEGRA
	select FB_CFB_FILLRECT
	select FB_CFB_COPYAREA
	select FB_CFB_IMAGEBLIT
        default FB
	help
	  This driver implements a dummy framebuffer device for systems based
	  on the NVIDIA Tegra family of SoCs. Display initialization is
	  expected to happen prior to the kernel start-up for this driver to
	  function.

config FB_TEGRA_GRHOST
	tristate "Tegra graphics host driver"
	depends on FB_TEGRA && TEGRA_IOVMM
        default n
	help
	  Driver for the Tegra graphics host hardware.

config DEVNVMAP
	bool "/dev/nvmap device support"
	depends on ARCH_TEGRA
	default y
	help
	  Say Y here if you want to support the /dev/nvmap device. This device
	  is used by NVIDIA Tegra graphics and multimedia drivers for managing
	  graphics memory.

config DEVNVMAP_PARANOID
	bool "Validate all user-provided /dev/nvmap object references"
	depends on DEVNVMAP
	default n
	help
	  Say Y here to enable additional process-level validations and
	  permissions for /dev/nvmap object references provided via ioctls.
	  May result in a decrease in performance.

config DEVNVMAP_RECLAIM_UNPINNED_VM
	bool "Allow /dev/nvmap to reclaim unpinned I/O virtual memory"
	depends on DEVNVMAP && TEGRA_IOVMM
	default y
	help
	  Say Y here to enable /dev/nvmap to reclaim I/O virtual memory after
	  it has been unpinned, and re-use it for other objects. This can
	  allow a larger virtual I/O VM space than would normally be
	  supported by the hardware, at a slight cost in performance.
```

## sound/soc/tegra/Kconfig
```kconfig
config SND_SOC_TEGRA
	tristate "SoC Audio for the Tegra System-on-Chip"
	depends on ARCH_TEGRA && TEGRA_SYSTEM_DMA
	depends on !TEGRA_LEGACY_AUDIO
	help
	  Say Y or M here if you want support for SoC audio on Tegra.

config SND_SOC_TEGRA20_DAS
	tristate "Tegra 20 Digital Audio Switch driver"
	depends on SND_SOC_TEGRA && ARCH_TEGRA_2x_SOC

config SND_SOC_TEGRA20_I2S
	tristate "Tegra 20 I2S driver"
	depends on SND_SOC_TEGRA && ARCH_TEGRA_2x_SOC
	select SND_SOC_TEGRA20_DAS
	help
	  Say Y or M if you want to add support for codecs attached to the
	  Tegra I2S interface. You will also need to select the individual
	  machine drivers to support below.

config SND_SOC_TEGRA30_AHUB
	tristate "Tegra 30 Audio Hub driver"
	depends on SND_SOC_TEGRA && ARCH_TEGRA_3x_SOC

config SND_SOC_TEGRA30_I2S
	tristate "Tegra 30 I2S driver"
	depends on SND_SOC_TEGRA && ARCH_TEGRA_3x_SOC
	select SND_SOC_TEGRA30_AHUB
	help
	  Say Y or M if you want to add support for codecs attached to the
	  Tegra I2S interface. You will also need to select the individual
	  machine drivers to support below.

config SND_SOC_TEGRA_SPDIF
	tristate
	depends on SND_SOC_TEGRA
	default m
	help
	  Say Y or M if you want to add support for the SPDIF interface.
	  You will also need to select the individual machine drivers to support
	  below.

config MACH_HAS_SND_SOC_TEGRA_WM8903
	bool
	help
	  Machines that use the SND_SOC_TEGRA_WM8903 driver should select
	  this config option, in order to allow the user to enable
	  SND_SOC_TEGRA_WM8903.

config SND_SOC_TEGRA_WM8903
	tristate "SoC Audio support for Tegra boards using a WM8903 codec"
	depends on SND_SOC_TEGRA && I2C
	depends on MACH_HAS_SND_SOC_TEGRA_WM8903
	select SND_SOC_TEGRA20_I2S if ARCH_TEGRA_2x_SOC
	select SND_SOC_TEGRA30_I2S if ARCH_TEGRA_3x_SOC
	select SND_SOC_WM8903
	help
	  Say Y or M here if you want to add support for SoC audio on Tegra
	  boards using the WM8093 codec. Currently, the supported boards are
	  Harmony, Ventana, Seaboard, Kaen, and Aebl.

config MACH_HAS_SND_SOC_TEGRA_WM8753
	bool
	help
	  Machines that use the SND_SOC_TEGRA_WM8753 driver should select
	  this config option, in order to allow the user to enable
	  SND_SOC_TEGRA_WM8753.

config SND_SOC_TEGRA_WM8753
	tristate "SoC Audio support for Tegra boards using a WM8753 codec"
	depends on SND_SOC_TEGRA && I2C
	depends on MACH_HAS_SND_SOC_TEGRA_WM8753
	select SND_SOC_TEGRA20_I2S if ARCH_TEGRA_2x_SOC
	select SND_SOC_TEGRA30_I2S if ARCH_TEGRA_3x_SOC
	select SND_SOC_WM8753
	help
	  Say Y or M here if you want to add support for SoC audio on Tegra
	  boards using the WM8753 codec. Currently, only supported board is
	  Whistler.

config MACH_HAS_SND_SOC_TEGRA_MAX98088
	bool
	help
	  Machines that use the SND_SOC_TEGRA_MAX98088 driver should select
	  this config option, in order to allow the user to enable
	  SND_SOC_TEGRA_MAX98088.

config SND_SOC_TEGRA_MAX98088
	tristate "SoC Audio support for Tegra boards using a MAX98088 codec"
	depends on SND_SOC_TEGRA && I2C
	depends on MACH_HAS_SND_SOC_TEGRA_MAX98088
	select SND_SOC_TEGRA20_I2S if ARCH_TEGRA_2x_SOC
	select SND_SOC_TEGRA30_I2S if ARCH_TEGRA_3x_SOC
	select SND_SOC_MAX98088
	help
	  Say Y or M here if you want to add support for SoC audio on Tegra
	  boards using the MAX98088 codec. Currently, only supported board is
	  Enterprise.
```
